## Documentation/devicetree/bindings/gpio/econet,en7523-gpio.yaml
```yaml
# SPDX-License-Identifier: GPL-2.0-only OR BSD-2-Clause
%YAML 1.2
---
$id: http://devicetree.org/schemas/gpio/econet,en7523-gpio.yaml#
$schema: http://devicetree.org/meta-schemas/core.yaml#

title: EcoNet EN7523 GPIO controller

maintainers:
  - John Crispin <nbd@nbd.name>

description: |
  Realtek's GPIO controller on their MIPS switch SoCs (Otto platform) consists
  of two banks of 32 GPIOs. These GPIOs can generate edge-triggered interrupts.
  Each bank's interrupts are cascased into one interrupt line on the parent
  interrupt controller, if provided.
  This binding allows defining a single bank in the devicetree. The interrupt
  controller is not supported on the fallback compatible name, which only
  allows for GPIO port use.

properties:
  $nodename:
    pattern: "^gpio@[0-9a-f]+$"

  compatible:
    items:
      - const: econet,en7523-gpio

  reg:
    items:
      - description: 

  "#gpio-cells":
    const: 2

  gpio-controller: true

required:
  - compatible
  - reg
  - "#gpio-cells"
  - gpio-controller

additionalProperties: false

examples:
  - |
      gpio@3500 {
        compatible = "realtek,rtl8380-gpio", "realtek,otto-gpio";
        reg = <0x3500 0x1c>;
        gpio-controller;
        #gpio-cells = <2>;
        ngpios = <24>;
        interrupt-controller;
        #interrupt-cells = <2>;
        interrupt-parent = <&rtlintc>;
        interrupts = <23>;
      };

...
```
