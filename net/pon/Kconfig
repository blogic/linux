## net/pon/Kconfig
```kconfig
# SPDX-License-Identifier: GPL-2.0-only
#
# PON subsystem configuration
#
config PON
	tristate "Passive Optical Network (PON) device support"
	depends on NET
	help
	  Enable kernel support for PON (GPON / XG(S)-PON) ONU devices: the
	  netlink configuration family (which also carries the OMCI
	  management channel to a userspace OMCI stack) and per GEM port
	  virtual devices.

	  To compile this as a module, choose M here: the module will be
	  called pon.

	  If unsure, say N.

config PON_KUNIT_TEST
	tristate "KUnit tests for the PON subsystem" if !KUNIT_ALL_TESTS
	depends on KUNIT
	depends on PON
	default KUNIT_ALL_TESTS
	help
	  Enable this option to test the PON subsystem with kunit: the
	  message codec (a pure function of the ITU-T wire format), the
	  lent context, the activation state, the FEC counters, the carrier,
	  the OMCI channel, the conduit, the GEM network devices, the
	  scheduler and flow offload and the netlink family. The tests run
	  against a PON MAC and a conduit that they provide, without any PON
	  hardware.

	  If unsure, say N.
```
